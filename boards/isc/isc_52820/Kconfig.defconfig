## build/Kconfig/Kconfig.shield
```kconfig
osource "D:/cust/sva_uptime_in_flash_10_uart_off/uptime_52840_beacon_v01-main/boards/shields/*/Kconfig.shield"
osource "C:/ncs/v2.9.2/nrf/boards/shields/*/Kconfig.shield"
```

## build/Kconfig/boards/Kconfig
```kconfig
# Load Zephyr board Kconfig descriptions.
osource "D:/cust/sva_uptime_in_flash_10_uart_off/uptime_52840_beacon_v01-main/boards/isc/isc_52820/Kconfig"
```

## build_1/Kconfig/Kconfig.shield
```kconfig
osource "D:/cust/sva_uptime_in_flash_10_uart_off/sva_uptime_in_flash_10_uart_off/boards/shields/*/Kconfig.shield"
osource "C:/ncs/v2.9.2/nrf/boards/shields/*/Kconfig.shield"
```

## build_1/uptime_52840_beacon_v01-main/Kconfig/boards/Kconfig.defconfig
```kconfig
# Load Zephyr board defconfig descriptions.
osource "D:/cust/sva_uptime_in_flash_10_uart_off/sva_uptime_in_flash_10_uart_off/boards/isc/isc_52820/Kconfig.defconfig"
```

## build_1/uptime_52840_beacon_v01-main/Kconfig/boards/Kconfig.sysbuild
```kconfig
# Load Sysbuild board Kconfig descriptions.
osource "D:/cust/sva_uptime_in_flash_10_uart_off/sva_uptime_in_flash_10_uart_off/boards/isc/isc_52820/Kconfig.sysbuild"
```
